## config/west.yml
```yaml
manifest:
  version: 1.2
  remotes:
    - name: cormoran
      url-base: https://github.com/cormoran
    - name: caksoylar
      url-base: https://github.com/caksoylar
  projects:
    # DYA Studio current ZMK fork
    - name: zmk
      remote: cormoran
      revision: main+dya
      clone-depth: 1
      import:
        file: app/west.yml

    # Zephyr revision used by the current DYA Dash stack
    - name: zephyr
      remote: cormoran
      revision: v4.1.0+zmk-fixes+nrf-half-duplex-uart
      clone-depth: 1
      import:
        name-blocklist:
          - ci-tools
          - hal_altera
          - hal_cypress
          - hal_infineon
          - hal_microchip
          - hal_nxp
          - hal_openisa
          - hal_silabs
          - hal_xtensa
          - hal_st
          - hal_ti
          - loramac-node
          - mcuboot
          - mcumgr
          - net-tools
          - openthread
          - edtt
          - trusted-firmware-m

    # DYA Studio modules required by roBa
    - name: zmk-driver-pmw3610-with-custom-studio-rpc
      remote: cormoran
      revision: main
    - name: zmk-module-ble-management
      remote: cormoran
      revision: main
    - name: zmk-module-settings-rpc
      remote: cormoran
      revision: main
    - name: zmk-module-runtime-input-processor
      remote: cormoran
      revision: main
    - name: zmk-feature-custom-settings
      remote: cormoran
      revision: main
    - name: zmk-feature-runtime-combo
      remote: cormoran
      revision: main
    - name: zmk-feature-runtime-macro
      remote: cormoran
      revision: main
    - name: zmk-feature-module-physical-layout
      remote: cormoran
      revision: main

    # XIAO BLE RGB LED battery / connection indicator
    - name: zmk-rgbled-widget
      remote: caksoylar
      revision: main

  self:
    path: config
```
